## meta-cassini/meta-cassini-distro/conf/distro/cassini.conf
```bitbake
# Copyright (c) 2022 Arm Limited or its affiliates. All rights reserved.
#
# SPDX-License-Identifier: MIT

require ${COREBASE}/meta-poky/conf/distro/poky.conf

# Introduce the CASSINI Yocto Distro
DISTRO = "cassini"
DISTRO_NAME = "CASSINI"
DISTRO_VERSION = "unstable"

# systemd as the init system
INIT_MANAGER = "systemd"
DISTRO_FEATURES:append = " virtualization ipv6 seccomp k3s"

# Apply feature specific config
USER_CLASSES:append = " cassini-distro-features"

# rpm as the package management system
PACKAGE_CLASSES ?= "package_rpm"

PREFERRED_PROVIDER_virtual/runc ?= "runc-opencontainers"
PREFERRED_PROVIDER_virtual/docker ?= "docker-ce"

# These classes produce warnings if there are any missing kernel configurations
# that are required by their target packages
KERNEL_CLASSES:append = " containers_kernelcfg_check k3s_kernelcfg_check"

# This variable is used to include cassini distro feature specific settings
CASSINI_OVERRIDES ??= ""

# Default user account names and default admin group name
CASSINI_USER_ACCOUNT ?= "user"
CASSINI_ADMIN_ACCOUNT ?= "cassini"
CASSINI_TEST_ACCOUNT ?= "test"
CASSINI_ADMIN_GROUP ?= "sudo"
CASSINI_ADMIN_GROUP_OPTIONS ?= "NOPASSWD:"

# Select whether or not to generate the filesystem able to run in any aarch64
# platform. If CASSINI_GENERIC_ARM64_FILESYSTEM is "1", armv8a-crc DEFAULTTUNE
# will be used otherwise the one set by the MACHINE conf will be selected.
CASSINI_GENERIC_ARM64_FILESYSTEM ?= "1"
CASSINI_GENERIC_ARM64_DEFAULTTUNE ?= "armv8a-crc"

# Use generic DEFAULTTUNE if generic filestystem enabled otherwise preserve
# DEFAULTTUNE value.
DEFAULTTUNE:aarch64 := "\
${@ d.getVar('CASSINI_GENERIC_ARM64_DEFAULTTUNE', False) \
    if (bb.utils.to_boolean(d.getVar('CASSINI_GENERIC_ARM64_FILESYSTEM', \
                                     True), False)) \
    else d.getVar('DEFAULTTUNE', False)}"
```

## meta-cassini/meta-cassini-distro/conf/distro/include/cassini-devel.inc
```bitbake
# Copyright (c) 2022 Arm Limited or its affiliates. All rights reserved.
#
# SPDX-License-Identifier: MIT

# config specifc to the cassini-devel distro feature, enabled using
# DISTRO_FEATURES

EXTRA_IMAGE_FEATURES:append = " debug-tweaks"
```

## meta-cassini/meta-cassini-distro/conf/distro/include/cassini-sdk.inc
```bitbake
# Copyright (c) 2022 Arm Limited or its affiliates. All rights reserved.
#
# SPDX-License-Identifier: MIT

# Config specifc to the cassini-sdk distro feature, enabled using
# DISTRO_FEATURES

IMAGE_FEATURES:append = " \
 package-management \
 dev-pkgs \
 tools-sdk \
 tools-debug \
 tools-profile \
 debug-tweaks \
 ssh-server-openssh"

IMAGE_INSTALL:append = " kernel-base kernel-devsrc kernel-modules"

IMAGE_INSTALL:append:aarch64 = " gator-daemon"
```

## meta-cassini/meta-cassini-distro/conf/distro/include/cassini-security.inc
```bitbake
# Copyright (c) 2022 Arm Limited or its affiliates. All rights reserved.
#
# SPDX-License-Identifier: MIT

# Config specifc to the cassini-security distro feature, enabled using
# DISTRO_FEATURES

CASSINI_OVERRIDES:append = ":cassini-security"

# Force password change after user first log in for:
# 'CASSINI_USER_ACCOUNT' & 'CASSINI_ADMIN_ACCOUNT',
# and disable root account login
EXTRA_USERS_PARAMS:append = "\
    usermod -s /sbin/nologin root; \
    passwd-expire ${CASSINI_ADMIN_ACCOUNT}; \
    passwd-expire ${CASSINI_USER_ACCOUNT}; \
    ${@bb.utils.contains('DISTRO_FEATURES', 'cassini-test', \
                        'passwd-expire ${CASSINI_TEST_ACCOUNT};', '', d)} \
    "
IMAGE_FEATURES:remove = "empty-root-password debug-tweaks"

# Allow users to ssh on first cassini image boot,
# if users have empty password preset
IMAGE_FEATURES:append = " allow-empty-password"

DISTRO_FEATURES:append = " seccomp"

KERNEL_FEATURES:append = " features/security/security.scc"

CASSINI_SECURITY_UMASK = "0027"

# Make sure that libcap[-ng] (Linux Capabilities) is enabled by default
# for all below packages:
# meta-openembedded/meta-networking
PACKAGECONFIG:append:pn-freeradius = " libcap"
PACKAGECONFIG:append:pn-libtalloc = " libcap"
PACKAGECONFIG:append:pn-libtevent = " libcap"
PACKAGECONFIG:append:pn-libldb = " libcap"
PACKAGECONFIG:append:pn-chrony = " libcap"
PACKAGECONFIG:append:pn-libtdb = " libcap"
PACKAGECONFIG:append:pn-wireshark = " libcap"
PACKAGECONFIG:append:pn-proftpd = " cap"
PACKAGECONFIG:append:pn-quagga = " cap"
PACKAGECONFIG:append:pn-cifs-utils = " cap"
PACKAGECONFIG:append:pn-ntp = " cap"
PACKAGECONFIG:append:pn-libgcrypt = " capabilities"
PACKAGECONFIG:append:pn-tcpdump = " libcap-ng"

# meta-openembedded/meta-oe
PACKAGECONFIG:append:pn-pax-utils = " libcap"
PACKAGECONFIG:append:pn-syslog-ng = " linux-caps"
PACKAGECONFIG:append:pn-smartmontools = " libcap-ng"

# poky/meta
PACKAGECONFIG:append:pn-iputils = " libcap"
PACKAGECONFIG:append:pn-pinentry = " libcap"
PACKAGECONFIG:append:pn-perf = " cap"
PACKAGECONFIG:append:pn-gstreamer1.0 = " setcap"
PACKAGECONFIG:append:pn-qemu = " libcap-ng"

# meta-virtualization
PACKAGECONFIG:append:pn-libvirt = " libcap-ng"
PACKAGECONFIG:append:pn-irqbalance = " libcap-ng"
PACKAGECONFIG:append:pn-openvswitch = " libcap-ng"
```

## meta-cassini/meta-cassini-distro/conf/distro/include/cassini-test.inc
```bitbake
# Copyright (c) 2022 Arm Limited or its affiliates. All rights reserved.
#
# SPDX-License-Identifier: MIT

# Config specifc to the cassini-test distro feature, enabled using
# DISTRO_FEATURES

DISTRO_FEATURES:append = " ptest"
EXTRA_IMAGE_FEATURES:append = " debug-tweaks"
IMAGE_INSTALL:append = " container-engine-integration-tests-ptest \
                         k3s-integration-tests-ptest \
                         user-accounts-integration-tests-ptest"

# With v1.6.0, BATS returns success with failing tests. The exit status of a
# BATS 'run' command called from the teardown_file() function is returned as
# the exit status of the bats script. This means that even if the test cases
# fail, a successful teardown will produce a passing test suite execution.
# This is a regression from v1.5.0.
# https://github.com/bats-core/bats-core/issues/575

# Update (10May2022): The reported bug was already fixed upstream and a patch
# has been sent to meta-oe to apply the backport fix on top of 1.6.0. This
# will be requested to have it also backported to kirkstone branch.
# When importing baremetal test, make sure to check the status and remove this
# compatibility.
# https://jira.arm.com/browse/OSSEMBEDA-1722
PREFERRED_VERSION_pn-bats = "1.5.0"
```

## meta-cassini/meta-cassini-distro/conf/layer.conf
```bitbake
# Copyright (c) 2022 Arm Limited or its affiliates. All rights reserved.
#
# SPDX-License-Identifier: MIT

# Add layer to BBPATH
BBPATH .= ":${LAYERDIR}"

# Add recipes-* directories to BBFILES
BBFILES += " \
    ${LAYERDIR}/recipes-*/*/*.bb \
    ${LAYERDIR}/recipes-*/*/*.bbappend \
    "

BBFILE_COLLECTIONS += "meta-cassini-distro"
BBFILE_PATTERN_meta-cassini-distro = "^${LAYERDIR}/"
LAYERDEPENDS_meta-cassini-distro = " \
   core \
   yocto \
"

LAYERSERIES_COMPAT_meta-cassini-distro = "kirkstone"

CASSINI_DISTRO_LAYERDIR := "${LAYERDIR}"
```

## meta-cassini/meta-cassini-tests/conf/layer.conf
```bitbake
# Copyright (c) 2022 Arm Limited or its affiliates. All rights reserved.
#
# SPDX-License-Identifier: MIT

# Add the path of this layer to BBPATH
BBPATH .= ":${LAYERDIR}"

# We have recipes-* directories, add to BBFILES
BBFILES += "${LAYERDIR}/recipes-*/*/*.bb \
            ${LAYERDIR}/recipes-*/*/*.bbappend"

BBFILE_COLLECTIONS += "meta-cassini-tests"
BBFILE_PATTERN_meta-cassini-tests = "^${LAYERDIR}/"

LAYERDEPENDS_meta-cassini-tests = " \
   core \
   openembedded-layer"

LAYERSERIES_COMPAT_meta-cassini-tests = "kirkstone"
```

## meta-ewaol-bsp/conf/distro/include/ewaol-bsp.inc
```bitbake
# Copyright (c) 2021, Arm Limited.
#
# SPDX-License-Identifier: MIT

EWAOL_MACHINE_EXTRAS ?= "${EWAOL_ARM_BSP_DYNAMIC_DIR}/conf/machine/ewaol-machine-extra-settings.inc"
require ${@bb.utils.contains('BBFILE_COLLECTIONS', 'meta-arm-bsp', \
                             '${EWAOL_MACHINE_EXTRAS}' , \
                             '', d)}
```

## meta-ewaol-bsp/conf/layer.conf
```bitbake
# Copyright (c) 2021-2022, Arm Limited.
#
# SPDX-License-Identifier: MIT

# Add layer to BBPATH
BBPATH .= ":${LAYERDIR}"

# Add recipes-* directories to BBFILES
BBFILES += " \
    ${LAYERDIR}/recipes-*/*/*.bb \
    ${LAYERDIR}/recipes-*/*/*.bbappend \
    "

BBFILE_COLLECTIONS += "meta-ewaol-bsp"
BBFILE_PATTERN_meta-ewaol-bsp = "^${LAYERDIR}/"
LAYERDEPENDS_meta-ewaol-bsp = " \
   core \
   meta-ewaol-distro \
"
LAYERSERIES_COMPAT_meta-ewaol-bsp = "kirkstone"

BBFILES_DYNAMIC += " \
    meta-arm-bsp:${LAYERDIR}/dynamic-layers/meta-arm-bsp/*/*/*.bbappend \
    meta-arm-bsp:${LAYERDIR}/dynamic-layers/meta-arm-bsp/*/*/*.bb \
    meta-adlink-ampere:${LAYERDIR}/dynamic-layers/meta-adlink-ampere/*/*/*.bbappend \
    meta-adlink-ampere:${LAYERDIR}/dynamic-layers/meta-adlink-ampere/*/*/*.bb \
"
# Root directory for the meta-ewaol-bsp/dynamic-layers/meta-arm-bsp
EWAOL_ARM_BSP_DYNAMIC_DIR := "${LAYERDIR}/dynamic-layers/meta-arm-bsp"

# Apply feature specific config
USER_CLASSES:append = " ewaol-bsp-features"
```

## meta-ewaol-bsp/dynamic-layers/meta-arm-bsp/conf/machine/ewaol-machine-extra-settings.inc
```bitbake
# Copyright (c) 2021, Arm Limited.
#
# SPDX-License-Identifier: MIT

# Require extra machine specific settings
ARM_BSP_DYN_MACHINE_EXTRA_REQUIRE ?= ""
ARM_BSP_DYN_MACHINE_EXTRA_REQUIRE:n1sdp = "n1sdp-extra-settings.inc"

require ${ARM_BSP_DYN_MACHINE_EXTRA_REQUIRE}
```

## meta-ewaol-bsp/dynamic-layers/meta-arm-bsp/conf/machine/n1sdp-extra-settings.inc
```bitbake
# Copyright (c) 2021-2022, Arm Limited.
#
# SPDX-License-Identifier: MIT

# Extra machine settings for n1sdp

# We need to extent the wks search path to be able to find custom wks file
WKS_SEARCH_PATH:prepend := "${EWAOL_ARM_BSP_DYNAMIC_DIR}/wic:"
WKS_FILE = "ewaol-virtualization-n1sdp-efidisk.wks.in"
GRUB_CFG_FILE ?= "${EWAOL_ARM_BSP_DYNAMIC_DIR}/wic/ewaol-virtualization-n1sdp-grub.cfg"

# Select the extra files to be included in the boot partition
IMAGE_EFI_BOOT_FILES += "xen-n1sdp.efi;xen.efi"
IMAGE_EFI_BOOT_FILES += "n1sdp-single-chip-xen.dtb"

EWAOL_WIC_IMAGE_EXTRA_DEPENDS ??= ""
do_image_wic[depends] += "${EWAOL_WIC_IMAGE_EXTRA_DEPENDS}"
```

## meta-ewaol-distro/conf/distro/ewaol.conf
```bitbake
# Copyright (c) 2021-2022, Arm Limited.
#
# SPDX-License-Identifier: MIT

# Apply feature specific config
# The `meta-ewaol-distro/classes/ewaol-distro-features.bbclass` enables
# conditional inclusion of `.inc` files to enable specific features based
# on the values in `DISTRO_FEATURES`.
# The `meta-cassini/meta-cassini-distro/classes/cassini-distro-features.bbclass`
# follows same concept to enable specific features. Therefore, we need to
# append `ewaol-distro-features.bbclass` before
# `cassini-distro-features.bbclass` to `USER_CLASSES`.
# DO NOT MODIFY the order of `USER_CLASSES:append` and `require`.
USER_CLASSES:append = " ewaol-distro-features"

# This is an unavoidable hack to include cassini.conf. Currently,
# meta-cassini distro is part of meta-ewaol and CI building ewaol
# clones meta-ewaol into layers folder and builds from there.
# For user builds, layers folder is under meta-ewaol. Due to this,
# path for cassini.conf need to be adjusted based on the build
# environment. This is a temporary hack and won't be needed when
# meta-cassini is separated from meta-ewaol.
CASSINI_CONFIG_FILE_REL_PATH := "\
${@ "../.." \
    if (d.getVar('BBLAYERS').find("layers/meta-ewaol") == -1) \
    else "../meta-ewaol"}"

require ${COREBASE}/${CASSINI_CONFIG_FILE_REL_PATH}/meta-cassini/meta-cassini-distro/conf/distro/cassini.conf

# EWAOL distro is based on Cassini distro and we need to keep cassini in
# OVERRIDES.
OVERRIDES:append = ":cassini"

# Introduce the EWAOL Yocto Distro
DISTRO = "ewaol"
DISTRO_NAME = "EWAOL (Edge Workload Abstraction and Orchestration Layer)"
DISTRO_VERSION = "v1.0"

# systemd as the init system
INIT_MANAGER = "systemd"
DISTRO_FEATURES:append = " virtualization ipv6 seccomp k3s"

# rpm as the package management system
PACKAGE_CLASSES ?= "package_rpm"

PREFERRED_PROVIDER_virtual/runc = "runc-opencontainers"
PREFERRED_PROVIDER_virtual/docker = "docker-ce"

# These classes produce warnings if there are any missing kernel configurations
# that are required by their target packages
KERNEL_CLASSES:append = " containers_kernelcfg_check k3s_kernelcfg_check"

# This variable is used to include ewaol distro feature specific settings
# e.g. for "ewaol-virtualization"
EWAOL_OVERRIDES ??= ""

# Default user account names and default admin group name
CASSINI_ADMIN_ACCOUNT = "ewaol"
EWAOL_TEST_ACCOUNT = "${@ d.getVar('CASSINI_TEST_ACCOUNT')}"
EWAOL_ADMIN_GROUP = "${@ d.getVar('CASSINI_ADMIN_GROUP')}"

# Select whether or not to generate the filesystem able to run in any aarch64
# platform. If EWAOL_GENERIC_ARM64_FILESYSTEM is "1", armv8a-crc DEFAULTTUNE
# will be used otherwise the one set by the MACHINE conf will be selected.
EWAOL_GENERIC_ARM64_FILESYSTEM ?= "1"
EWAOL_GENERIC_ARM64_DEFAULTTUNE ?= "armv8a-crc"

# Use generic DEFAULTTUNE if generic filestystem enabled otherwise preserve
# DEFAULTTUNE value.
DEFAULTTUNE:aarch64 := "\
${@ d.getVar('EWAOL_GENERIC_ARM64_DEFAULTTUNE', False) \
    if (bb.utils.to_boolean(d.getVar('EWAOL_GENERIC_ARM64_FILESYSTEM', \
                                     True), False)) \
    else d.getVar('DEFAULTTUNE', False)}"
```

## meta-ewaol-distro/conf/distro/include/ewaol-baremetal.inc
```bitbake
# Copyright (c) 2022, Arm Limited.
#
# SPDX-License-Identifier: MIT

# config specifc to the ewaol-baremetal distro feature, enabled using
# DISTRO_FEATURES

IMAGE_FEATURES:append = " debug-tweaks"
```

## meta-ewaol-distro/conf/distro/include/ewaol-devel.inc
```bitbake
# Copyright (c) 2021, Arm Limited.
#
# SPDX-License-Identifier: MIT

# config specifc to the ewaol-devel distro feature, enabled using
# DISTRO_FEATURES

EXTRA_IMAGE_FEATURES_append = " debug-tweaks"
```

## meta-ewaol-distro/conf/distro/include/ewaol-guest-vm.inc
```bitbake
# Copyright (c) 2022, Arm Limited.
#
# SPDX-License-Identifier: MIT

# Guest multiconfig build configuration file basename without the ".conf"
# suffix.
EWAOL_GUEST_VM_MC ?= "${@ 'ewaol-guest-vm' if d.getVar('BUILD_EWAOL_GUEST_VM') == 'True' else ''}"

# By default, a Guest VM's hostname will be "${EWAOL_GUEST_VM_HOSTNAME}${IDX}"
# where EWAOL_GUEST_VM_HOSTNAME is common for all VMs, and ${IDX} is the Guest
# VM's integer instance index.
EWAOL_GUEST_VM_HOSTNAME ?= "ewaol-guest-vm"

# The variable 'ewaol_guest_vm_instance' remains empty in each recipe
# until it is set as a for-loop iterator in particular task.
EWAOL_GUEST_VM_IMAGE_BASENAME = "ewaol-guest-vm${ewaol_guest_vm_instance}-image"
EWAOL_GUEST_VM_IMAGE_RECIPE ?= "ewaol-guest-vm-image"
EWAOL_GUEST_VM_KERNEL_IMAGETYPE ?= "Image"
EWAOL_GUEST_VM_MACHINE ?= "generic-arm64"
EWAOL_GUEST_VM_TMPDIR = "${TOPDIR}/tmp_${EWAOL_GUEST_VM_MC}"

EWAOL_GUEST_VM_MEMORY_SIZE_DEFAULT = "6144"
EWAOL_GUEST_VM_ROOTFS_EXTRA_SPACE_DEFAULT = "0"
EWAOL_GUEST_VM_NUMBER_OF_CPUS_DEFAULT = "4"

EWAOL_GUEST_VM_INSTANCES ?= "1"

BUILD_EWAOL_GUEST_VM = "${@ \
    'False' if (not d.getVar('EWAOL_GUEST_VM_INSTANCES') \
                or int(d.getVar('EWAOL_GUEST_VM_INSTANCES')) < 1) \
            else 'True'}"

PREBUILT_GUEST_VM_INSTANCES ?= "0"

INCLUDE_PREBUILT_GUEST_VM = "${@ \
    'False' if (not d.getVar('PREBUILT_GUEST_VM_INSTANCES') \
                or int(d.getVar('PREBUILT_GUEST_VM_INSTANCES')) < 1) \
            else 'True'}"
```

## meta-ewaol-distro/conf/distro/include/ewaol-sdk.inc
```bitbake
# Copyright (c) 2021-2022, Arm Limited.
#
# SPDX-License-Identifier: MIT

# Config specifc to the ewaol-sdk distro feature, enabled using
# DISTRO_FEATURES

DISTRO_FEATURES:append = " cassini-sdk"
```
