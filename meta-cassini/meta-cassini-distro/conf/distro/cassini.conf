## meta-ewaol-distro/conf/distro/include/ewaol-security.inc
```bitbake
# Copyright (c) 2022, Arm Limited.
#
# SPDX-License-Identifier: MIT

# Config specifc to the ewaol-security distro feature, enabled using
# DISTRO_FEATURES

EWAOL_OVERRIDES:append = ":ewaol-security"

DISTRO_FEATURES:append = " cassini-security"

EWAOL_SECURITY_UMASK = "${@ d.getVar('CASSINI_SECURITY_UMASK')}"
```

## meta-ewaol-distro/conf/distro/include/ewaol-test.inc
```bitbake
# Copyright (c) 2021-2022, Arm Limited.
#
# SPDX-License-Identifier: MIT

# Config specifc to the ewaol-test distro feature, enabled using
# DISTRO_FEATURES

DISTRO_FEATURES:append = " ptest"
EXTRA_IMAGE_FEATURES:append = " debug-tweaks"
IMAGE_INSTALL:append = " container-engine-integration-tests-ptest \
                         k3s-integration-tests-ptest \
                         user-accounts-integration-tests-ptest"

IMAGE_INSTALL:append = "${@bb.utils.contains('DISTRO_FEATURES',\
    'ewaol-virtualization', ' virtualization-integration-tests-ptest', '', d)}"
```

## meta-ewaol-distro/conf/distro/include/ewaol-virtualization.inc
```bitbake
# Copyright (c) 2021-2022, Arm Limited.
#
# SPDX-License-Identifier: MIT

# config specifc to the ewaol-virtualization distro feature, enabled using
# DISTRO_FEATURES

EWAOL_OVERRIDES:append = ":ewaol-virtualization"

DISTRO_FEATURES:append = " xen"

IMAGE_FEATURES:append = " debug-tweaks"

EWAOL_GUEST_VM_INC = "conf/distro/include/ewaol-guest-vm.inc"
require ${@ '${EWAOL_GUEST_VM_INC}' if '${BB_CURRENT_MC}' == 'default' else ''}

EWAOL_CONTROL_VM_MEMORY_SIZE ?= "2048"

KERNEL_CLASSES:append = " xen_kernelcfg_check"
```

## meta-ewaol-distro/conf/distro/include/ewaol-vm.inc
```bitbake
# Copyright (c) 2022, Arm Limited.
#
# SPDX-License-Identifier: MIT

# Guest multiconfig build configuration file basename without the ".conf"
# suffix.
EWAOL_VM_MC ?= "${@ 'ewaol-vm' if d.getVar('BUILD_EWAOL_VM') == 'True' else ''}"

EWAOL_VM_HOSTNAME ?= "ewaol-vm"

# The variable 'ewaol_vm_instance' remains empty in each recipe
# until it is set as a for loop iterator in particular task.
EWAOL_VM_IMAGE_BASENAME = "ewaol-vm${ewaol_vm_instance}-image"
EWAOL_VM_IMAGE_RECIPE ?= "ewaol-vm-image"
EWAOL_VM_KERNEL_IMAGETYPE ?= "Image"
EWAOL_VM_MACHINE ?= "generic-arm64"
EWAOL_VM_TMPDIR = "${TOPDIR}/tmp_${EWAOL_VM_MC}"

EWAOL_VM_MEMORY_SIZE_DEFAULT = "6144"
EWAOL_VM_ROOTFS_EXTRA_SPACE_DEFAULT = "0"
EWAOL_VM_NUMBER_OF_CPUS_DEFAULT = "4"

EWAOL_VM_INSTANCES ?= "1"

BUILD_EWAOL_VM = "${@ 'False' if (not d.getVar('EWAOL_VM_INSTANCES') \
                                or int(d.getVar('EWAOL_VM_INSTANCES')) < 1) \
                              else 'True'}"

PREBUILT_VM_INSTANCES ?= "0"

INCLUDE_PREBUILT_VM = "${@ 'False' if (not d.getVar('PREBUILT_VM_INSTANCES') \
                                or int(d.getVar('PREBUILT_VM_INSTANCES')) < 1) \
                              else 'True'}"
```

## meta-ewaol-distro/conf/layer.conf
```bitbake
# Copyright (c) 2021-2022, Arm Limited.
#
# SPDX-License-Identifier: MIT

# Add layer to BBPATH
BBPATH .= ":${LAYERDIR}"

# Add recipes-* directories to BBFILES
BBFILES += " \
    ${LAYERDIR}/recipes-*/*/*.bb \
    ${LAYERDIR}/recipes-*/*/*.bbappend \
    "

BBFILE_COLLECTIONS += "meta-ewaol-distro"
BBFILE_PATTERN_meta-ewaol-distro = "^${LAYERDIR}/"
LAYERDEPENDS_meta-ewaol-distro = " \
   core \
   yocto \
   virtualization-layer \
   ${@bb.utils.contains('DISTRO_FEATURES', \
                        'ewaol-virtualization', \
                        'meta-arm', '', d)} \
"

LAYERSERIES_COMPAT_meta-ewaol-distro = "langdale"

EWAOL_DISTRO_LAYERDIR := "${LAYERDIR}"
```

## meta-ewaol-distro/wic/ewaol-guest-vm.wks
```
# Copyright (c) 2021-2022, Arm Limited.
#
# SPDX-License-Identifier: MIT

part / --source rootfs --ondisk sda --fstype=ext4 --label root --align 1024 --extra-space 100 --use-uuid

bootloader  --ptable gpt
```

## meta-ewaol-distro/wic/ewaol-vm.wks
```
# Copyright (c) 2021, Arm Limited.
#
# SPDX-License-Identifier: MIT

part / --source rootfs --ondisk sda --fstype=ext4 --label root --align 1024 --extra-space 100 --use-uuid

bootloader  --ptable gpt
```

## meta-ewaol-tests/conf/layer.conf
```bitbake
# Copyright (c) 2021-2022, Arm Limited.
#
# SPDX-License-Identifier: MIT

# Add the path of this layer to BBPATH
BBPATH .= ":${LAYERDIR}"

# We have recipes-* directories, add to BBFILES
BBFILES += "${LAYERDIR}/recipes-*/*/*.bb \
            ${LAYERDIR}/recipes-*/*/*.bbappend"

BBFILE_COLLECTIONS += "meta-ewaol-tests"
BBFILE_PATTERN_meta-ewaol-tests = "^${LAYERDIR}/"

LAYERDEPENDS_meta-ewaol-tests = " \
   core \
   openembedded-layer"

LAYERSERIES_COMPAT_meta-ewaol-tests = "langdale"
```
